#include <Wire.h>
#include "MAX30105.h"

#include <MPU6050_tockn.h>

#include "heartRate.h"

#include <SPI.h>
//#include <Adafruit_GFX.h>
#include <Adafruit_SSD1306.h>

#include <Timer.h>

#include <OneWire.h>
#include <DallasTemperature.h>

#define SCREEN_WIDTH 128 // OLED display width, in pixels
#define SCREEN_HEIGHT 64 // OLED display height, in pixels

// Declaration for an SSD1306 display connected to I2C (SDA, SCL pins)
#define OLED_RESET     4 // Reset pin # (or -1 if sharing Arduino reset pin)
Adafruit_SSD1306 display(SCREEN_WIDTH, SCREEN_HEIGHT, &Wire, OLED_RESET);

#define LOGO_HEIGHT   64
#define LOGO_WIDTH    128
// 'pepe_oled', 128x64px
const unsigned char logo_bmp [] PROGMEM = {
0x00, 0x00, 0x00, 0x00, 0x00, 0x00, 0x00, 0x00, 0x00, 0x00, 0x00, 0x00, 0x00, 0x00, 0x00, 0x00, 
0x00, 0x00, 0x00, 0x00, 0x00, 0x00, 0x00, 0x00, 0x00, 0x00, 0x00, 0x00, 0x00, 0x00, 0x00, 0x00, 
0x00, 0x00, 0x00, 0x00, 0x00, 0x00, 0x00, 0x00, 0x00, 0x00, 0x00, 0x00, 0x00, 0x00, 0x00, 0x00, 
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0x00, 0x7f, 0xff, 0xff, 0xff, 0xff, 0xfe, 0x00, 0x00, 0x00, 0x00, 0x00, 0x00, 0x00, 0x00, 0x00
};


#define TEXT_HEIGHT   60
#define TEXT_WIDTH    106
const unsigned char displayText [] PROGMEM = {
0x00, 0x00, 0x00, 0x00, 0x01, 0x00, 0x00, 0x00, 0x00, 0x40, 0x00, 0x00, 0x00, 0x00, 0x00, 0x0c, 
0x00, 0x00, 0xe1, 0x80, 0x00, 0x00, 0x03, 0xe0, 0x10, 0x0e, 0x38, 0x00, 0x00, 0x08, 0x00, 0x00, 
0x83, 0x00, 0x60, 0x01, 0xfe, 0x00, 0x0c, 0x0c, 0x30, 0x00, 0x00, 0x08, 0x0c, 0x01, 0x87, 0xff, 
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0x70, 0x00, 0x60, 0x00, 0x00, 0x03, 0x00, 0x00
};

MAX30105 particleSensor;

const byte RATE_SIZE = 4; //Increase this for more averaging. 4 is good.
byte rates[RATE_SIZE]; //Array of heart rates
byte rateSpot = 0;
long lastBeat = 0; //Time at which the last beat occurred

float beatsPerMinute;
int beatAvg;

/********************************************************************/
// Data wire is plugged into pin 2 on the Arduino 
#define ONE_WIRE_BUS 32
/********************************************************************/
// Setup a oneWire instance to communicate with any OneWire devices  
// (not just Maxim/Dallas temperature ICs) 
OneWire oneWire(ONE_WIRE_BUS); 
/********************************************************************/
// Pass our oneWire reference to Dallas Temperature. 
DallasTemperature bodyTempSensor(&oneWire);
/********************************************************************/ 
float bodyTemp;

int acc[3] = {0,0,0};
int gyr[3] = {0,0,0};

Timer tempTimer;
Timer mpu6050Timer;

MPU6050 mpu6050(Wire);

// OneWire DS18S20, DS18B20, DS1822 Temperature Example
//
// http://www.pjrc.com/teensy/td_libs_OneWire.html
//
// The DallasTemperature library can do all this work for you!
// https://github.com/milesburton/Arduino-Temperature-Control-Library

OneWire  ds(32);  // on pin 10 (a 4.7K resistor is necessary)


void heartRateSensorSetup(){
  // Initialize sensor
  if (!particleSensor.begin(Wire, I2C_SPEED_FAST)) //Use default I2C port, 400kHz speed
  {
    Serial.println("MAX30105 was not found. Please check wiring/power. ");
    while (1);
  }
  Serial.println("Place your index finger on the sensor with steady pressure.");

  particleSensor.setup(); //Configure sensor with default settings
  particleSensor.setPulseAmplitudeRed(0x0A); //Turn Red LED to low to indicate sensor is running
  particleSensor.setPulseAmplitudeGreen(0); //Turn off Green
}

class OLED{
  public:
    Adafruit_SSD1306 *oled;
    
    OLED(Adafruit_SSD1306 *oled){
      this->oled = oled;
      // SSD1306_SWITCHCAPVCC = generate display voltage from 3.3V internally
      if(!oled->begin(SSD1306_SWITCHCAPVCC, 0x3C)) { // Address 0x3C for 128x32
        Serial.println(F("SSD1306 allocation failed"));
        for(;;); // Don't proceed, loop forever
      }
    
      // Show initial display buffer contents on the screen --
      // the library initializes this with an Adafruit splash screen.
      oled->display();
      delay(2000); // Pause for 2 seconds
      clear();
    }

    void display_logo(bool light_up) {
      int color = light_up? SSD1306_WHITE : SSD1306_BLACK;
      oled->drawBitmap(
      (oled->width()  - LOGO_WIDTH ) / 2,
      (oled->height() - LOGO_HEIGHT) / 2,
      logo_bmp, LOGO_WIDTH, LOGO_HEIGHT, color);
      oled->display();
    }

    void display_text(String text, int x, int y, bool light_up) {
      int color = light_up? SSD1306_WHITE : SSD1306_BLACK;
      oled->setTextSize(1);             // Normal 1:1 pixel scale
      oled->setTextColor(color);        // Draw white text
      oled->setCursor(x,y);             // Start at top-left corner
      oled->println(text);
      oled->display();
    }
    
    void display_text(String text, int x, int y, bool light_up, int text_size) {
      int color = light_up? SSD1306_WHITE : SSD1306_BLACK;
      oled->setTextSize(text_size);             // Normal 1:1 pixel scale
      oled->setTextColor(color);        // Draw white text
      oled->setCursor(x,y);             // Start at top-left corner
      oled->println(text);
      oled->display();
    }
    
    void display_text_pic(bool light_up) {
      int color = light_up? SSD1306_WHITE : SSD1306_BLACK;
      oled->drawBitmap(
        (oled->width()  -  TEXT_WIDTH) / 2,
        (oled->height() - TEXT_HEIGHT) / 2,
        displayText, TEXT_WIDTH, TEXT_HEIGHT, color);
      oled->display();
    }

    void display_pixel(int x, int y, bool light_up){
        int color = light_up? SSD1306_WHITE : SSD1306_BLACK;
        // Draw a single pixel in white
        oled->drawPixel(x, y, color);
        // Show the display buffer on the screen. You MUST call display() after
        // drawing commands to make them visible on screen!
        oled->display();
    }
    
    void clear(){
      oled->clearDisplay();
    }
    
};

#define INITIAL_PAGE 0
#define MAIN_PAGE 1
#define TEMP_PAGE 2
#define MOVE_PAGE 3
#define MENU_PAGE 4
#define TOTAL_PAGE 5

/* ------------------------------------------------------------------------

main_page -> temp_page -> move_page -> main_page
         Right       Right        Right

main_page <- temp_page <- move_page <- main_page
         Left         Left         Left
         
main_page -> menu_page  |  main_page <- menu_page
         Enter          |            Back

--------------------------------------------------------------------------- */
// page is the same base object of different page that the oled will display
class Page{
  public:
    // methods that can be override
    virtual void show(OLED oled){}
    virtual void clear(OLED oled){}
};

class InitialPage: public Page{
  public:
    void show(OLED oled){
      for (int i = 0; i < 6; i++){
        oled.display_pixel(10+i*5, 32, true);
        delay(500);
      }

      for (int i = 0; i < 6; i++){
        oled.display_pixel(10+i*5, 32, false);
      }
      
      oled.display_text("Welcome back, Eddy!", 0, 32, true);
      delay(2000);
      oled.display_text("Welcome back, Eddy!", 0, 32, false);
      
      //oled.display_text_pic(true);
      //delay(3000);
      //oled.display_text_pic(false);

      //oled.display_logo(true);
      //delay(3000);
      //oled.display_logo(false);
      
    }
};

class MainPage: public Page{
  public:
    void show(OLED oled){
      oled.display_text("BMP: ", 0, 22, true, 1);
      oled.display_text("TMP: ", 0, 32, true, 1);
      oled.display_text("Ang: ", 0, 42, true, 1);
      oled.display_text("Acc: ", 0, 52, true, 1);
    }

    void clear(OLED oled){
      oled.display_text("BMP: ", 0, 22, false, 1);
      oled.display_text("TMP: ", 0, 32, false, 1);
      oled.display_text("Ang: ", 0, 42, false, 1);
      oled.display_text("Acc: ", 0, 52, false, 1);
    }
};

class MenuPage: public Page{
  public:
    void show(OLED oled){
      oled.display_text("Wifi: ", 0, 22, true, 1);
      oled.display_text("Power: ", 0, 32, true, 1);
      oled.display_text("Send: ", 0, 42, true, 1);
      oled.display_text("Back: ", 0, 52, true, 1);
    }
        
    void clear(OLED oled){
      oled.display_text("Wifi: ", 0, 22, false, 1);
      oled.display_text("Power: ", 0, 32, false, 1);
      oled.display_text("Send: ", 0, 42, false, 1);
      oled.display_text("Back ", 0, 52, false, 1);
    }
};

class TempPage: public Page{
  public:
    void show(OLED oled){
      oled.display_text("Temperature: ", 0, 22, true, 1);
    }
        
    void clear(OLED oled){
      oled.display_text("Temperature: ", 0, 22, false, 1);
    }
};

class MovePage: public Page{
  public:
    void show(OLED oled){
      oled.display_text("Acceleration: ", 0, 22, true, 1);
      oled.display_text("Euler Angle: ", 0, 42, true, 1);
    }
        
    void clear(OLED oled){
      oled.display_text("Acceleration: ", 0, 22, false, 1);
      oled.display_text("Euler Angle: ", 0, 42, false, 1);
    }
};

class PageMonitor{
  private:
    Page *pages[TOTAL_PAGE];
    int current_page = -1;
    OLED *oled;
    
  public:
    void set(OLED *oled, Page *pages[]){
      this->oled = oled;
      for (int i = 0 ; i < TOTAL_PAGE; i++){
        this-> pages[i] = pages[i];
      }
    }

    void show(int page_num){
      if (current_page != -1){
        pages[current_page]->clear(*oled);
      }
      pages[page_num]->show(*oled);
      current_page = page_num;
    }

    int get_current_page(){
      return current_page;
    }
};


#define ENTER_BUTTON 0
#define ENTER_BUTTON_PIN 33
#define BACK_BUTTON 1
#define BACK_BUTTON_PIN 35
#define LEFT_BUTTON 2
#define LEFT_BUTTON_PIN 34
#define RIGHT_BUTTON 3
#define RIGHT_BUTTON_PIN 36

#define TOTAL_BUTTON 4

class Button{
  public:
    int pin_num;
    // override function that trigger when user push button
    virtual void call(PageMonitor *page_monitor){}
    
    void set(int pin_num){
      this->pin_num = pin_num;
      pinMode(pin_num, INPUT);
    }
    
    bool check_state(){
      // digitalRead function stores the Push button state 
      // in variable push_button_state
      int Push_button_state = digitalRead(pin_num);
      // if condition checks if push button is pressed
      if ( Push_button_state == HIGH )
        return true;
      else
        return false;
    }
};

class EnterButton: public Button{
  public:
    // when enter button is called
    void call(PageMonitor *page_monitor){
      Serial.println("press enter button");
      int current_page = page_monitor->get_current_page();
      switch(current_page){
        // when the location is at MENU_PAGE
        case MAIN_PAGE:
          page_monitor->show(MENU_PAGE);
          break;
        case MENU_PAGE:
          // check cursor and click
          break;
        case TEMP_PAGE:
          page_monitor->show(MENU_PAGE);
          break;
        case MOVE_PAGE:
          page_monitor->show(MENU_PAGE);
          break;
        case INITIAL_PAGE:
          // nothing needs to be happen
          break;
      }
    }
};

class BackButton: public Button{
  public:
    void call(PageMonitor *page_monitor){
      Serial.println("press back button");
      int current_page = page_monitor->get_current_page();
      switch(current_page){
        // when the location is at MENU_PAGE
        case MAIN_PAGE:
          //nothing needs to be happen
          break;
        case MENU_PAGE:
          page_monitor->show(MAIN_PAGE);
          break;
        case TEMP_PAGE:
          page_monitor->show(MAIN_PAGE);
          break;
        case MOVE_PAGE:
          page_monitor->show(MAIN_PAGE);
          break;
        case INITIAL_PAGE:
          //nothing needs to be happen
          break;
      }
    }
};

class LeftButton: public Button{
  public:
    void call(PageMonitor *page_monitor){
      Serial.println("press left button");
      int current_page = page_monitor->get_current_page();
      switch(current_page){
        // when the location is at MENU_PAGE
        case MAIN_PAGE:
          page_monitor->show(MOVE_PAGE);
          break;
        case MENU_PAGE:
          // move cursor (up)
          break;
        case TEMP_PAGE:
          page_monitor->show(MAIN_PAGE);
          break;
        case MOVE_PAGE:
          page_monitor->show(TEMP_PAGE);
          break;
        case INITIAL_PAGE:
          //nothing needs to be happen
          break;
      }
    }
};

class RightButton: public Button{
  public:
    void call(PageMonitor *page_monitor){
      Serial.println("press right button");
      int current_page = page_monitor->get_current_page();
      switch(current_page){
        // when the location is at MENU_PAGE
        case MAIN_PAGE:
          page_monitor->show(TEMP_PAGE);
          break;
        case MENU_PAGE:
          //move cursor (down)
          break;
        case TEMP_PAGE:
          page_monitor->show(MOVE_PAGE);
          break;
        case MOVE_PAGE:
          page_monitor->show(MAIN_PAGE);
          break;
        case INITIAL_PAGE:
          //nothing needs to be happen
          break;
      }
    }
};

// Button Monitor is used to control different buttons
class ButtonMonitor{
  public:
    Button *buttons[TOTAL_BUTTON];
    int button_hold = -1;
    Timer timer;
    
    void set(Button *buttons[]){
      for (int i = 0; i < TOTAL_BUTTON; i++){
        this->buttons[i] = buttons[i];
      }
      timer.settimer(100);
      timer.starttimer();
    }

    // check whether any button is triggered
    void check_trigger(PageMonitor *page_monitor){
      if (timer.checkfinish()){
      bool any_button_on = false;
      for (int i = 0; i < TOTAL_BUTTON; i++){
        if (buttons[i]->check_state()){
          if (button_hold == -1){
            buttons[i]->call(page_monitor);
            button_hold = i;
          }
          any_button_on = true;
          timer.resettimer();
          timer.starttimer();
        }
      }
      
      if (!any_button_on)
        button_hold = -1;
      }
    }
    
};


// Create PageMonitor and pages that is needed
PageMonitor page_monitor;
Page *pages[TOTAL_PAGE];
InitialPage initial_page;
MainPage main_page;
MenuPage menu_page;
TempPage temp_page;
MovePage move_page;

// Create button and the function
ButtonMonitor button_monitor;
Button *buttons[TOTAL_BUTTON];
EnterButton enter_button;
BackButton back_button;
RightButton right_button;
LeftButton left_button;

// initialize the pages the smartwatch needed
void page_initialize(){
  // PAGE SETUP --------------------------------
  pages[INITIAL_PAGE] = &initial_page;
  pages[MAIN_PAGE] = &main_page;
  pages[MENU_PAGE] = &menu_page;
  pages[MOVE_PAGE] = &move_page;
  pages[TEMP_PAGE] = &temp_page;
  
  // create a page monitor
  page_monitor.set(new OLED(&display), pages);
  // -------------------------------------------
}

void button_initialize(){
  // BUTTON SETUP ------------------------------
  enter_button.set(ENTER_BUTTON_PIN);
  buttons[ENTER_BUTTON] = &enter_button;
  
  back_button.set(BACK_BUTTON_PIN);
  buttons[BACK_BUTTON] = &back_button;
  
  right_button.set(RIGHT_BUTTON_PIN);
  buttons[RIGHT_BUTTON] = &right_button;
  
  left_button.set(LEFT_BUTTON_PIN);
  buttons[LEFT_BUTTON] = &left_button;
  
  button_monitor.set(buttons); // create a button monitor
  // -------------------------------------------
}

void setup()
{
  Serial.begin(115200);
  Serial.println("Initializing...");

  page_initialize();
  
  button_initialize();

  page_monitor.show(INITIAL_PAGE);
  page_monitor.show(MAIN_PAGE);
  
  //heartRateSensorSetup();

  Wire.begin();
  mpu6050.begin();

  // 21:47:15.290 -> X : 1.63
  // 21:47:15.290 -> Y : 0.43
  // 21:47:15.290 -> Z : -2.67
  mpu6050.calcGyroOffsets(1.63,0.43,-2.67);

  bodyTempSensor.begin(); 
  
  tempTimer.settimer(2000);
  tempTimer.starttimer();

  mpu6050Timer.settimer(1000);
  mpu6050Timer.starttimer();  
}

String lastStrBeatAvg = "";
String strBeatAvg;
String lastStrTemp = "";
String strTemp;

String strAcc;
String strGyr;
String laststrAcc;
String laststrGyr;
/*
void oledDisplayLoop(){
  if (lastStrBeatAvg != strBeatAvg){
    oledClearText(lastStrBeatAvg,30, 22, 1);
    oledDisplayText(strBeatAvg, 30, 22, false, 1);
  }
  lastStrBeatAvg = strBeatAvg;

  if (lastStrTemp != strTemp){
    oledClearText(lastStrTemp,30, 32, 1);
    oledDisplayText(strTemp, 30, 32, false, 1);    
  }
  lastStrTemp = strTemp;

  if (laststrGyr != strGyr){
    oledClearText(laststrGyr,30, 42, 1);
    oledDisplayText(strGyr, 30, 42, false, 1);    
  }
  laststrGyr = strGyr;

  if (laststrAcc != strAcc){
    oledClearText(laststrAcc,30, 52, 1);
    oledDisplayText(strAcc, 30, 52, false, 1);    
  }
  laststrAcc = strAcc;
  
}
*/
void readTemperature(){
   // call sensors.requestTemperatures() to issue a global temperature 
   // request to all devices on the bus 
  /********************************************************************/
   //Serial.print(" Requesting temperatures..."); 
   bodyTempSensor.requestTemperatures(); // Send the command to get temperature readings 
   //Serial.println("DONE"); 
  /********************************************************************/
   Serial.print("Temperature is: ");
   bodyTemp = bodyTempSensor.getTempCByIndex(0);
   strTemp = String(bodyTemp);
   Serial.print(bodyTemp);
   
}

void readMPU6050(){
  mpu6050.update();

  if(mpu6050Timer.checkfinish()){
    
    Serial.println("=======================================================");
    //Serial.print("temp : ");Serial.println(mpu6050.getTemp());
    acc[0] = (int)(mpu6050.getAccX()*9.81);
    acc[1] = (int)(mpu6050.getAccY()*9.81);
    acc[2] = (int)(mpu6050.getAccZ()*9.81);
    Serial.print("accX : ");Serial.print(acc[0]);
    Serial.print("\taccY : ");Serial.print(acc[1]);
    Serial.print("\taccZ : ");Serial.println(acc[2]);
  
    //Serial.print("gyroX : ");Serial.print(mpu6050.getGyroX());
    //Serial.print("\tgyroY : ");Serial.print(mpu6050.getGyroY());
    //Serial.print("\tgyroZ : ");Serial.println(mpu6050.getGyroZ());
  
    //Serial.print("accAngleX : ");Serial.print(mpu6050.getAccAngleX());
    //Serial.print("\taccAngleY : ");Serial.println(mpu6050.getAccAngleY());

    gyr[0] = (int)mpu6050.getGyroAngleX();
    gyr[1] = (int)mpu6050.getGyroAngleY();
    gyr[2] = (int)mpu6050.getGyroAngleZ();
  
    Serial.print("gyroAngleX : ");Serial.print(gyr[0]);
    Serial.print("\tgyroAngleY : ");Serial.print(gyr[1]);
    Serial.print("\tgyroAngleZ : ");Serial.println(gyr[2]);
    
    //Serial.print("angleX : ");Serial.print(mpu6050.getAngleX());
    //Serial.print("\tangleY : ");Serial.print(mpu6050.getAngleY());
    //Serial.print("\tangleZ : ");Serial.println(mpu6050.getAngleZ());
    Serial.println("=======================================================\n");

    strGyr = "(" + String(gyr[0]) + "," + String(gyr[1]) + "," + String(gyr[2]) + ")";
    strAcc = "(" + String(acc[0]) + "," + String(acc[1]) + "," + String(acc[2]) + ")";
    
    mpu6050Timer.resettimer();
    mpu6050Timer.starttimer();
  }
}

void loop()
{

  button_monitor.check_trigger(&page_monitor);
  
  /*
  if (tempTimer.checkfinish()){
    readTemperature();
    tempTimer.resettimer();
    tempTimer.starttimer();
  }
  
  long irValue = particleSensor.getIR();
  if (checkForBeat(irValue) == true)
  {
    //We sensed a beat!
    long delta = millis() - lastBeat;
    lastBeat = millis();

    beatsPerMinute = 60 / (delta / 1000.0);

    if (beatsPerMinute < 255 && beatsPerMinute > 20)
    {
      rates[rateSpot++] = (byte)beatsPerMinute; //Store this reading in the array
      rateSpot %= RATE_SIZE; //Wrap variable

      //Take average of readings
      beatAvg = 0;
      for (byte x = 0 ; x < RATE_SIZE ; x++)
        beatAvg += rates[x];
      beatAvg /= RATE_SIZE;
    }
  }  
  
  Serial.print("IR=");
  Serial.print(irValue);
  Serial.print(", BPM=");
  Serial.print(beatsPerMinute);
  Serial.print(", Avg BPM=");
  Serial.print(beatAvg);
  
  
  if (irValue < 50000){
  //  Serial.print(" No finger?");
    strBeatAvg = "No finger";
  }
  else {
    strBeatAvg = String(beatAvg);
  }  
  
  Serial.println();

  readMPU6050();

  oledDisplayLoop();
  */
}
